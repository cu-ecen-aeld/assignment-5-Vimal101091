## base_external/package/ldd/Config.in
```kconfig
config BR2_PACKAGE_LDD
    bool "ldd kernel modules"
    depends on BR2_LINUX_KERNEL
    help
      Build and install LDD kernel modules (hello, faulty, scull)
```
